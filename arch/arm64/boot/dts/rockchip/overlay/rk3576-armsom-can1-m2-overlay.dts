/dts-v1/;
/plugin/;

#include <dt-bindings/clock/rockchip,rk3576-cru.h>

/ {
	metadata {
		title = "can1-m2";
		category = "misc";
		compatible = "rockchip,rk3576-armsom-cm5-io", "rockchip,rk3576-armsom-cm5-custom-io";
		exclusive = "can1", "GPIO4_B4", "GPIO4_B5";
	};

	fragment@0 {
		target = <&can1>;

		__overlay__ {
			status = "okay";
			assigned-clocks = <&cru CLK_CAN1>;
			assigned-clock-rates = <100000000>;
			pinctrl-names = "default";
			pinctrl-0 = <&can1m2_pins>;
		};
	};
};
