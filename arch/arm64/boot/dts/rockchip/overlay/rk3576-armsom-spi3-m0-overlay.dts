/dts-v1/;
/plugin/;

#include <dt-bindings/gpio/gpio.h>
#include <dt-bindings/pinctrl/rockchip.h>

/ {
	metadata {
		title = "spi3-m0";
		category = "misc";
		compatible = "armsom,rk3588-armsom-cm5-cm4-nano-b-io", "rockchip,rk3576-armsom-cm5-io";
		exclusive = "spi3", "GPIO3_A0", "GPIO3_A1", "GPIO3_A2", "GPIO3_A3";
	};

	fragment@0 {
		target = <&spi3>;

		__overlay__ {
			status = "okay";
			#address-cells = <1>;
			#size-cells = <0>;
			pinctrl-names = "default";
			pinctrl-0 = <&spi3m0_csn0 &spi3m0_pins>;
			num-cs = <1>;

			spi_dev@0 {
				compatible = "rockchip,spidev";
				reg = <0>; //chip select 0:cs0  1:cs1
				spi-max-frequency = <24000000>; //spi output clock
			};
		};
	};
};
