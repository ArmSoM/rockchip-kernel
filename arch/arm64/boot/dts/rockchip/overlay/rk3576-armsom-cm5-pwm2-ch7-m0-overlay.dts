// SPDX-License-Identifier: (GPL-2.0+ OR MIT)
/dts-v1/;
/plugin/;


/ {
	metadata {
		title = "pwm2-ch7-m0";
		category = "misc";
		compatible = "rockchip,rk3576-armsom-cm5-custom-io";
		exclusive = "pwm2-ch7", "GPIO4_B3";
		description = "CUSTOM CARRIER ONLY. CN1-30 (3.3 V). Replaces SAI1 SDI0. Shares PWM2 CH7 with pwm2-ch7-m2.";
	};

	fragment@0 {
		target = <&pwm2_8ch_7>;
		__overlay__ {
			status = "okay";
			pinctrl-names = "active";
			pinctrl-0 = <&pwm2m0_ch7>;
		};
	};
};
