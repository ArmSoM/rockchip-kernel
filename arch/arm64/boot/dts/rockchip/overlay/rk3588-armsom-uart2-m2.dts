/dts-v1/;
/plugin/;

/ {

	fragment@0 {
		target = <&fiq_debugger>;

		__overlay__ {
			status = "okay";
			rockchip,serial-id = <0xffffffff>;
		};
	};

	fragment1 {
		target = <&uart2>;

		__overlay__ {
			status = "okay";
			pinctrl-0 = <&uart2m2_xfer>;
		};
	};
};
