// SPDX-License-Identifier: (GPL-2.0+ OR MIT)
/dts-v1/;
/plugin/;


/ {
	metadata {
		title = "pwm1-ch1-m0";
		category = "misc";
		compatible = "rockchip,rk3576-armsom-cm5-io", "rockchip,rk3576-armsom-cm5-custom-io";
		exclusive = "pwm1-ch1", "GPIO0_B5";
		description = "CN1-41 (3.3 V). Reuses display backlight PWM. Disconnect the display; mutually exclusive with the DSI panel. Enabling the controller alone does not start a PWM waveform.";
	};

	fragment@0 {
		target = <&pwm1_6ch_1>;
		__overlay__ {
			status = "okay";
			pinctrl-names = "active";
			pinctrl-0 = <&pwm1m0_ch1>;
		};
	};
};
