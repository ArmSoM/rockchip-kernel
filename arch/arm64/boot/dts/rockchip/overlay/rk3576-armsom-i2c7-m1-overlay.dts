/dts-v1/;
/plugin/;

/ {
	metadata {
		title = "i2c7-m1";
		category = "misc";
		compatible = "armsom,rk3588-armsom-cm5-cm4-nano-b-io", "rockchip,rk3576-armsom-cm5-io", "rockchip,rk3576-armsom-cm5-custom-io";
		exclusive = "i2c7", "GPIO3_A0", "GPIO3_A1";
	};

	fragment@0 {
		target = <&i2c7>;

		__overlay__ {
			status = "okay";
			pinctrl-names = "default";
			pinctrl-0 = <&i2c7m1_xfer>;
		};
	};
};
