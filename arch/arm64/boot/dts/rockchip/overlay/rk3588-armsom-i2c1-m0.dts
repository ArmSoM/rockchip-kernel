/dts-v1/;
/plugin/;

/ {

	fragment@0 {
		target = <&fiq_debugger>;

		__overlay__ {
			status = "disabled";
		};
	};

	fragment@1 {
		target = <&i2c1>;

		__overlay__ {
			status = "okay";
			pinctrl-0 = <&i2c1m0_xfer>;
		};
	};
};
