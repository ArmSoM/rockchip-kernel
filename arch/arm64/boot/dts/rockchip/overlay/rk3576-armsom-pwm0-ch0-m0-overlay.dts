/dts-v1/;
/plugin/;

/ {
	metadata {
		title = "pwm0-ch0-m0";
		category = "misc";
		compatible = "rockchip,rk3576-armsom-aim5-io", "armsom,rk3588-armsom-cm5-cm4-nano-b-io", "rockchip,rk3576-armsom-cm5-io", "rockchip,rk3576-armsom-cm5-custom-io", "rockchip,rk3588-armsom-sige5";
		exclusive = "pwm0-ch0", "GPIO0_C4";
	};

	fragment@0 {
		target = <&pwm0_2ch_0>;

		__overlay__ {
			status = "okay";
			pinctrl-names = "active";
			pinctrl-0 = <&pwm0m0_ch0>;
		};
	};
};
