/dts-v1/;
/plugin/;

#include <dt-bindings/clock/rockchip,rk3576-cru.h>

/ {
	metadata {
		title = "can1-m3";
		category = "misc";
		compatible = "armsom,rk3588-armsom-cm5-cm4-nano-b-io", "rockchip,rk3576-armsom-cm5-io", "rockchip,rk3576-armsom-cm5-custom-io";
		exclusive = "can1", "GPIO3_A2", "GPIO3_A3";
	};

	fragment@0 {
		target = <&can1>;

		__overlay__ {
			status = "okay";
			assigned-clocks = <&cru CLK_CAN1>;
			assigned-clock-rates = <100000000>;
			pinctrl-names = "default";
			pinctrl-0 = <&can1m3_pins>;
		};
	};
};
